VERSION ""

NS_ :

BS_:

BU_:

BO_ 291 Status: 8 Vector__XXX
 SG_ AliveCounter : 32|8@1+ (1,0) [0|0] "" Vector__XXX
 SG_ Payload m3 : 16|16@1+ (1,0) [0|0] "" Vector__XXX
 SG_ SubMode M : 8|8@1+ (1,0) [0|0] "" Vector__XXX
 SG_ Mode M : 0|8@1+ (1,0) [0|0] "" Vector__XXX

SG_MUL_VAL_ 291 SubMode Mode 1-2;
SG_MUL_VAL_ 291 Payload SubMode 3-3;
